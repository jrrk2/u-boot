## arch/riscv/dts/clock.its
```
/*
 * Simple U-Boot uImage source file containing a single kernel and FDT blob
 */

/dts-v1/;

/ {
        description = "U-Boot fitImage for LowRISC clock setting";
	#address-cells = <1>;

	images {
		default = "script";
                script {
                       description = "script";
                       data = /incbin/("clock.cmd");
                       type = "script";
                       compression = "none";
		       hash-1 {	algo = "sha1"; };
                       };
	};

	configurations {
		default = "conf-1";
		conf-1 {
			description = "Set clock from DHCP";
		};
	};
};
```

## arch/riscv/dts/startup.its
```
/*
 * Simple U-Boot uImage source file containing a single kernel and FDT blob
 */

/dts-v1/;

/ {
        description = "U-Boot fitImage for LowRISC";
	#address-cells = <1>;

	images {
		default = "script";
                script {
                       description = "script";
                       data = /incbin/("startup.cmd");
                       type = "script";
                       compression = "none";
		       hash-1 {	algo = "sha1"; };
                        };
		kernel {
                        description = "Linux kernel";
                        data = /incbin/("../../../../riscv-pk/build/bbl.bin");
			type = "kernel";
			arch = "riscv";
			os = "linux";
			compression = "none";
			load = <0x80000000>;
			entry = <0x80000000>;
			hash-1 { algo = "sha1"; };
		};
		fdt-1 {
			description = "Flattened Device Tree blob";
                        data = /incbin/("../../../../fpga/src/etherboot/nexys4_ddr_rocket.dtb");
			type = "flat_dt";
			arch = "riscv";
                        load = <0x87000000>;
			compression = "none";
			hash-1 { algo = "sha1"; };
		};
	};

	configurations {
		default = "conf-1";
		conf-1 {
			description = "Boot Linux kernel with FDT blob";
			kernel = "kernel";
			fdt = "fdt-1";
		};
	};
};
```

## board/lowrisc/nexys4ddr/Kconfig
```kconfig
if TARGET_LOWRISC_NEXYS4DDR

config SYS_BOARD
	default "nexys4ddr"

config SYS_VENDOR
	default "lowrisc"

config SYS_CPU
	default "generic"

config SYS_CONFIG_NAME
	default "lowrisc-nexys4ddr"

config SYS_TEXT_BASE
	default 0x80000000 if !RISCV_SMODE
	default 0x80200000 if RISCV_SMODE

config BOARD_SPECIFIC_OPTIONS # dummy
	def_bool y
	select GENERIC_RISCV
	imply CMD_DHCP
	imply CMD_EXT2
	imply CMD_EXT4
	imply CMD_FAT
	imply CMD_FS_GENERIC
	imply CMD_NET
	imply CMD_PING
	imply CMD_MMC
	imply DOS_PARTITION
	imply EFI_PARTITION
	imply IP_DYN
	imply ISO_PARTITION
	imply MACB
	imply MII
	imply NET_RANDOM_ETHADDR
	imply PHY_LIB
	imply PHY_MSCC
	imply SPI
	imply MMC
	imply MMC_SPI
	imply MMC_BROKEN_CD
	imply DM_GPIO
	imply CMD_GPIO
	imply SMP

endif
```

## configs/lowrisc_nexys4ddr_defconfig
```kconfig
CONFIG_RISCV=y
CONFIG_ENV_SIZE=0x20000
CONFIG_NR_DRAM_BANKS=1
CONFIG_TARGET_LOWRISC_NEXYS4DDR=y
CONFIG_ARCH_RV64I=y
CONFIG_RISCV_SMODE=y
CONFIG_DISTRO_DEFAULTS=y
CONFIG_FIT=y
CONFIG_MISC_INIT_R=n
CONFIG_DISPLAY_CPUINFO=y
CONFIG_DISPLAY_BOARDINFO=y
CONFIG_OF_PRIOR_STAGE=n
CONFIG_SYS_RELOC_GD_ENV_ADDR=y
CONFIG_DM_MTD=y
CONFIG_SMP=n
CONFIG_XIP=y
CONFIG_OF_CONTROL=y
CONFIG_OF_EMBED=y
CONFIG_DEBUG_UART=y
CONFIG_DEBUG_UART_BASE=0x41000000
CONFIG_DEBUG_UART_CLOCK=50000000
CONFIG_DEBUG_UART_BOARD_INIT=y
CONFIG_DEBUG_UART_SHIFT=2
CONFIG_DEBUG_UART_NS16550_CHECK_ENABLED=y
CONFIG_DEFAULT_DEVICE_TREE="lowrisc_nexys4ddr.dts"
CONFIG_RISCV_MMODE=y
CONFIG_REQUIRE_SERIAL_CONSOLE=y
CONFIG_SERIAL_SEARCH_ALL=y
CONFIG_LOG_MAX_LEVEL=6
CONFIG_SYS_NS16550=y
CONFIG_LOG=y
CONFIG_BLK=y
CONFIG_LOWRISC_PITONSD=y
#CONFIG_SYS_TEXT_BASE=0x87d9a000
CONFIG_SYS_TEXT_BASE=0x80000000
CONFIG_CMD_MD5SUM=y
CONFIG_CMD_DATE=y
CONFIG_CMD_TIME=y
CONFIG_CMD_GETTIME=y
CONFIG_CMD_TIMER=y
CONFIG_CMD_UUID=y
CONFIG_LOWRISC_ETH100BASET=y
CONFIG_NET_RANDOM_ETHADDR=n
CONFIG_CMD_SNTP=y
CONFIG_CMD_DNS=y
CONFIG_CMD_RARP=y
CONFIG_CMD_TFTPBOOT=y
CONFIG_CMD_TFTPSRV=y
CONFIG_BOOTP_PXE=n
CONFIG_UPDATE_TFTP=n
CONFIG_CMD_TFTPGET=y
CONFIG_CMD_TFTPPUT=y
CONFIG_BOOTP_TIMEOFFSET=y
CONFIG_EFI_LOADER=n
CONFIG_BOOTDELAY=5
CONFIG_LEGACY_IMAGE_FORMAT=n
CONFIG_SYS_LONGHELP=y
CONFIG_CMD_BDI=y
CONFIG_CMD_ELF=y
CONFIG_LZ4=y
CONFIG_LZMA=y
CONFIG_LZO=y
CONFIG_GZIP=y
CONFIG_ZLIB=y
CONFIG_ZSTD=n
CONFIG_SYS_BOOT_GET_CMDLINE=n
CONFIG_DM_RTC=y
CONFIG_RTC_LOWRISC=y
```
